## drivers/gpu/Kconfig
```kconfig
# Added by HTC Display/Graphics for msm gpu driver

config MSM_KGSL_ADRENO200
        bool "MSM 3D Graphics driver for Adreno200"
        depends on FB_MSM && ARCH_MSM7X27A
        default y
        help
          3D graphics driver for Adreno200. Required to
          use hardware accelerated OpenGL ES 2.0 and 1.1 on these
          chips.

if MSM_KGSL_ADRENO200
source "drivers/gpu/msm/Kconfig"
endif
```
